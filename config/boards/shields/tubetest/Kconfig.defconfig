## config/boards/shields/tubetest/Kconfig.defconfig
```kconfig
if SHIELD_TUBETEST

config ZMK_KEYBOARD_NAME
    default "tubetest"

CONFIG_BT=y
CONFIG_BT_PERIPHERAL=y
CONFIG_BT_DEVICE_NAME="tubetest"
CONFIG_ZMK_BLE=y
CONFIG_ZMK_BLE_BONDABLE=y
CONFIG_BT_CTLR_TX_PWR_PLUS_8=y

CONFIG_ZMK_KEYBOARD_NAME="Mumble"
CONFIG_ZMK_SLEEP=y
CONFIG_ZMK_IDLE SLEEP_TIMEOUT=3600000
endif
```
